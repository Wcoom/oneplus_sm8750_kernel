## drivers/crystalfrostwork/Kconfig
```kconfig
#
# CrystalFrostwork kernel private drivers configuration
#
menuconfig CRYSTALFROSTWORK
	bool "CrystalFrostwork kernel private drivers"
	default y
	help
		Author: 阿菌•未霜 <799620521@qq.com>
		Copyright 2019-2025 阿菌•未霜 (799620521@qq.com) All rights reserved.

if CRYSTALFROSTWORK

source "drivers/crystalfrostwork/crystal_hybridswap/Kconfig"

endif
```

## drivers/crystalfrostwork/crystal_hybridswap/Kconfig
```kconfig
# SPDX-License-Identifier: GPL-2.0

config CRYSTAL_HYBRIDSWAP
	tristate "Crystal Hybridswap zram replacement framework"
	depends on BLOCK && SYSFS && MMU
	depends on ZRAM=n
	depends on MEMCG
	depends on CGROUPS
	depends on CRYPTO_LZO || CRYPTO_LZ4 || CRYPTO_LZ4HC || CRYPTO_LZ4K || CRYPTO_LZ4KD || CRYPTO_DEFLATE || CRYPTO_842 || CRYPTO_ZSTD
	select EVENTFD
	select ZSMALLOC
	select CRYSTAL_HYBRIDSWAP_ZRAM_WRITEBACK
	help
	  Build the Crystal Hybridswap rewrite compatibility framework with
	  its own zram ABI-compatible block driver/data plane.  This option
	  conflicts with CONFIG_ZRAM because it registers the zram block
	  device, zram-control class, and zram sysfs ABI itself.  It still
	  intentionally avoids the old extent/rmap/synchronous fault-out data
	  path.  Swapout requests are routed through zram page writeback;
	  zram handles per-slot readback on fault.

config CRYSTAL_HYBRIDSWAP_LEGACY_EMPTY_APIS
	bool "Expose legacy empty Crystal Hybridswap compatibility APIs"
	depends on CRYSTAL_HYBRIDSWAP
	default n
	help
	  Expose compatibility-only Crystal Hybridswap ABI files that currently
	  do not provide functional behavior and are kept solely for old
	  userspace.  This includes memory.aging_anon, memory.swapd_pid,
	  memory.psi, memory.ub_ufs2zram_ratio and the zram max_comp_streams
	  no-op sysfs attribute.  Leave this disabled unless old userspace
	  explicitly depends on these placeholder files.  Enabling it does not
	  restore the old OPPO extent/rmap/fault-out data path and does not wire
	  these placeholder APIs into the core policy.

config CRYSTAL_HYBRIDSWAP_LEGACY_SWAPD_MEMCGS_PARAM
	bool "Enable legacy memory.swapd_memcgs_param memcg policy control"
	depends on CRYSTAL_HYBRIDSWAP
	default n
	help
	  Enable the old Hybridswap memory.swapd_memcgs_param compatibility
	  control logic for memcg swapd policy.  This legacy ABI stores score
	  levels and per-level parameters from old userspace; the tuple contains
	  compatibility/saved-only fields such as ub_mem2zram_ratio and
	  refault_threshold, plus fields that still affect Crystal automatic
	  per-memcg zram-to-UFS writeback when this option is enabled, including
	  min_score, max_score and ub_zram2ufs_ratio.

	  Leave this disabled unless old userspace explicitly depends on the
	  legacy memcg swapd policy ABI.  When disabled, memory.swapd_memcgs_param
	  is not exposed and the old score/ratio policy is not used to select or
	  weight Crystal automatic memcg writeback candidates.

config CRYSTAL_HYBRIDSWAP_ERM_AVAIL_BUFFER_DEFAULT_ON
	bool "Enable ERM avail buffer override by default"
	depends on CRYSTAL_HYBRIDSWAP
	default y
	help
	  Enable the memory.erm_avail_buffer override path by default.  This lets
	  an OSvelte/ERM userspace daemon provide effective min/high available
	  memory watermarks while Crystal Hybridswap keeps its own zram, quota,
	  device-life, backoff, and writeback target guards.

	  The runtime memory.erm_avail_buffer_enable knob can still disable or
	  re-enable the override path without changing the base memory.avail_buffers
	  ABI values.

config CRYSTAL_HYBRIDSWAP_ZRAM_WRITEBACK
	bool "zram writeback support for Crystal Hybridswap"
	depends on CRYSTAL_HYBRIDSWAP
	default y
	help
	  Keep backing_dev/writeback support inside the private zram driver.  The
	  writeback data plane uses Crystal ZMS to pack compressed zram objects
	  into PAGE_SIZE backing blocks with volatile in-memory metadata.  This is
	  required by
	  the migrated hybridswap data path so force_swapout and automatic
	  policy writeback can move idle or incompressible zram objects to the
	  configured backing device without reintroducing the old extent data
	  plane.

config CRYSTAL_HYBRIDSWAP_ZRAM_TRACK_ENTRY_ACTIME
	bool "Track zram entry access time for Crystal Hybridswap"
	depends on CRYSTAL_HYBRIDSWAP
	default y
	help
	  Track per-entry access time so idle writeback can use age-based idle
	  marking like upstream zram.  Crystal Hybridswap uses this to preserve
	  the legacy policy knobs while keeping readback at the zram slot/page
	  layer instead of exposing an external extent fault-out interface.

config CRYSTAL_HYBRIDSWAP_ZRAM_MEMORY_TRACKING
	bool "Track zram block state for Crystal Hybridswap"
	depends on CRYSTAL_HYBRIDSWAP && DEBUG_FS
	select CRYSTAL_HYBRIDSWAP_ZRAM_TRACK_ENTRY_ACTIME
	help
	  Expose zram debugfs block_state information under the zram debugfs
	  root.  The directory and per-device names intentionally match upstream
	  zram debugfs naming, while the Kconfig conflict with CONFIG_ZRAM
	  prevents both providers from registering the same debugfs ABI.

config CRYSTAL_HYBRIDSWAP_ZRAM_MULTI_COMP
	bool "Enable multiple compression streams for zram replacement"
	depends on CRYSTAL_HYBRIDSWAP
	help
	  Enable upstream zram-style secondary recompression streams in the
	  private zram driver.  This keeps the standard zram
	  recomp_algorithm and recompress sysfs attributes available when the
	  extra compressors are configured, without changing the userspace ABI
	  away from zram.

config CRYSTAL_HYBRIDSWAP_SDDC
	bool "Huawei-style SDDC support for Crystal Hybridswap"
	depends on CRYSTAL_HYBRIDSWAP
	default y
	help
	  Enable the private integration points used by Crystal Hybridswap's
	  similarity detection and delta-compression data path.  It is enabled by
	  default when Crystal Hybridswap is enabled; the representation remains
	  opportunistic and falls back to ordinary compression on resource loss.

config CRYSTAL_HYBRIDSWAP_SDDC_LZ4KD
	bool "Private LZ4KD delta codec"
	depends on CRYSTAL_HYBRIDSWAP_SDDC
	depends on ARM64_4K_PAGES
	default y
	help
	  Build a private copy of Huawei's LZ4KD ordinary and delta codec and
	  expose it to the Crystal zcomp frontend as "lz4kd".  It does not alter
	  the kernel Crypto API or register a global compression algorithm.

	  The codec format and its 8 KiB delta window require 4 KiB pages.

config CRYSTAL_HYBRIDSWAP_SDDC_ZMS_NATIVE
	bool "Native SDDC DELTA writeback to ZMS"
	depends on CRYSTAL_HYBRIDSWAP_SDDC
	depends on CRYSTAL_HYBRIDSWAP_ZRAM_WRITEBACK
	default y
	help
	  Keep resident LZ4KD SDDC DELTA wire data intact when it is written to
	  Crystal ZMS.  The immutable reference remains resident in SDDC and is
	  protected by a sparse writeback state until the ZMS object is released.
	  Ordinary and unsupported SDDC representations continue to use the
	  flatten-to-ordinary-stream writeback path.

config CRYSTAL_HYBRIDSWAP_SDDC_KUNIT_TEST
	bool "KUnit tests for private SDDC and LZ4KD"
	depends on KUNIT=y
	depends on CRYSTAL_HYBRIDSWAP_SDDC_LZ4KD
	default n
	help
	  Test ordinary and delta round trips, raw 4 KiB payloads, malformed
	  streams, and the full 8 KiB reference/current boundary.  Also exercise
	  the higher-level SDDC reference publication, generation cookies, slot
	  ownership, snapshot identity, stale-job rejection, flatten retry, wire
	  header validation, and manager admission state.

config CRYSTAL_HYBRIDSWAP_ZRAM_DEF_COMP
	string "Default Crystal Hybridswap zram compressor"
	depends on CRYSTAL_HYBRIDSWAP
	default "lz4kd" if CRYSTAL_HYBRIDSWAP_SDDC_LZ4KD
	default "lz4kd" if CRYPTO_LZ4KD
	default "lz4" if CRYPTO_LZ4
	default "lzo" if CRYPTO_LZO
	default "lz4hc" if CRYPTO_LZ4HC
	default "lz4k" if CRYPTO_LZ4K
	default "deflate" if CRYPTO_DEFLATE
	default "842" if CRYPTO_842
	default "zstd" if CRYPTO_ZSTD
	help
	  Select the primary compressor used by the private Crystal Hybridswap
	  zram device before userspace changes /sys/block/zramX/comp_algorithm.
	  The value must name an algorithm supported by the current zcomp
	  configuration, such as lzo, lzo-rle, lz4, lz4kd, or zstd.  The private
	  LZ4KD backend is selected directly and all other algorithms continue to
	  use the kernel Crypto API.

config CRYSTAL_HYBRIDSWAP_DEF_DISKSIZE_RATIO
	int "Default zram disksize as a fraction of RAM (0 to disable)"
	depends on CRYSTAL_HYBRIDSWAP
	range 0 8
	default 2
	help
	  Size the private Crystal Hybridswap zram device at boot as
	  totalram / N, so 2 means a 1:2 ratio (12 GB of zram on a 24 GB
	  phone).  This only sets an initial disksize; userspace can still
	  reset the device and pick another size later.  Set to 0 to keep the
	  historical behaviour of leaving disksize unset until userspace
	  writes /sys/block/zramX/disksize.

	  Note the ratio is against physical RAM, not a promise of that much
	  extra memory: zram stores pages compressed, so the backing cost is
	  roughly disksize divided by the achieved compression ratio.
```

## drivers/rekernel_x/Kconfig
```kconfig
config REKERNEL_X
	bool "ReKernel-X kernel events"
	depends on NET
	default y
	help
	  ReKernel-X: expose binder/signal/network kernel events to
	  userspace via Generic Netlink family "rekernel_x2".
```

## vendor/Kconfig
```kconfig
#
# Vendor kernel modules configuration
#

menuconfig VENDOR_KERNEL_MODULES
	bool "OnePlus vendor kernel modules"
	default n

if VENDOR_KERNEL_MODULES

source "vendor/mm/Kconfig"

endif
```

## vendor/mm/Kconfig
```kconfig
config OPLUS_FEATURE_PERFORMANCE_MM
	bool "config oplus kernel mm feature"
	default n
	help
	  define this config to add oplus kernel mm feature

if OPLUS_FEATURE_PERFORMANCE_MM

source "vendor/mm/mm_osvelte/Kconfig"

source "vendor/mm/hybridswap_zram/Kconfig"

endif
```

## vendor/mm/hybridswap_zram/Kconfig.gki
```kconfig
#
# GKI kernel modules feature configuration
#

config HYBRIDSWAP_OPLUS_SCHEDINFO
	bool "Hybridswap oneplus sched info support"
	depends on HYBRIDSWAP_ZRAM && HYBRIDSWAP && !HYBRIDSWAP_ZRAM_WRITEBACK
	select OPLUS_FEATURE_UXMEM_OPT
	default n

config OPLUS_FEATURE_UXMEM_OPT
	bool
```
